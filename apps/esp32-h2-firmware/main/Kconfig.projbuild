## apps/esp32-h2-firmware/main/Kconfig.projbuild
```kconfig
menu "LED Control Node"

config LED_CONTROL_TEST_BUILD
    bool "Enable non-flashable automated test build"
    default n
    help
        scripts/esp32-h2-build.sh --test-build가 자동 target compile 검증에만 사용한다.
        이 설정의 binary는 HIL 또는 양산 장비에 flash하면 안 된다.

config LED_CONTROL_LAB_HIL_BUILD
    bool "Enable flashable Lab HIL build"
    default n
    depends on !LED_CONTROL_TEST_BUILD
    help
        Bluetooth SIG Company Identifier 발급 전 실장비 HIL에만 사용한다.
        비양산 RFU 0xFFFE를 사용하며 판매·배포·양산에 사용할 수 없다.

config LED_CONTROL_BLUETOOTH_COMPANY_ID
    int "Bluetooth SIG assigned company identifier"
    range 1 65535
    help
        Bluetooth SIG가 자사에 할당한 Company Identifier를 10진수로 지정한다.
        Gateway의 GATEWAY_BLUETOOTH_COMPANY_ID와 반드시 같은 값이어야 한다.
        65535는 LED_CONTROL_TEST_BUILD, 65534는 LED_CONTROL_LAB_HIL_BUILD 전용이다.

config DFK_PRODUCT_FAMILY
    int "DFK product family code"
    default 1
    range 0 255

config DFK_MODEL_CODE
    int "DFK model code"
    default 1
    range 0 255

config DFK_HARDWARE_REVISION
    int "DFK hardware revision"
    default 1
    range 0 255

config LED_CONTROL_PWM_GPIO
    int "LED driver PWM GPIO"
    default 8

config LED_CONTROL_FACTORY_RESET_GPIO
    int "Factory reset active-low GPIO"
    default 9

config LED_CONTROL_VEHICLE_SENSOR_GPIO
    int "3.3V Active High microwave sensor GPIO"
    default 4
    range 0 27
    help
        안전 후보는 GPIO 0, 1, 4, 5, 10~14, 22~24다. PWM과 factory reset,
        strapping, flash, package 전용 및 USB-Serial-JTAG pin 충돌은 compile 시 거부한다.
        기본 UART0 console의 RX GPIO23/TX GPIO24와 custom console GPIO도 제외한다.

config LED_CONTROL_FACTORY_RESET_HOLD_MS
    int "Factory reset hold duration (ms)"
    default 8000
    range 3000 30000

endmenu
```

## apps/esp32-h2-firmware/sdkconfig.defaults
```kconfig
CONFIG_IDF_TARGET="esp32h2"
CONFIG_BT_ENABLED=y
CONFIG_BT_NIMBLE_ENABLED=y
CONFIG_BLE_MESH=y
CONFIG_BLE_MESH_NODE=y
CONFIG_BLE_MESH_RELAY=y
CONFIG_BLE_MESH_GATT_PROXY_SERVER=y
CONFIG_BLE_MESH_PB_ADV=y
CONFIG_BLE_MESH_PB_GATT=y
CONFIG_BLE_MESH_TX_SEG_MSG_COUNT=10
CONFIG_BLE_MESH_RX_SEG_MSG_COUNT=10
CONFIG_BLE_MESH_GENERIC_SERVER=y
CONFIG_BLE_MESH_LIGHTING_SERVER=y
CONFIG_BLE_MESH_HEALTH_SRV=y
CONFIG_PARTITION_TABLE_TWO_OTA=y
CONFIG_ESPTOOLPY_FLASHSIZE_4MB=y
CONFIG_ESP_TASK_WDT_EN=y
CONFIG_ESP_TASK_WDT_INIT=y
CONFIG_ESP_TASK_WDT_TIMEOUT_S=10
CONFIG_LED_CONTROL_PWM_GPIO=8
CONFIG_LED_CONTROL_FACTORY_RESET_GPIO=9
CONFIG_LED_CONTROL_FACTORY_RESET_HOLD_MS=8000
CONFIG_DFK_PRODUCT_FAMILY=1
CONFIG_DFK_MODEL_CODE=1
CONFIG_DFK_HARDWARE_REVISION=1
```
